#include "oled.h"

extern I2C_HandleTypeDef hi2c1;

/* --------------------------------------------------------------------------
 * FP1 – Fonctions bas-niveau I2C (SSD1306)
 * -------------------------------------------------------------------------- */
void OLED_WriteCommand(uint8_t cmd) {
    HAL_I2C_Mem_Write(&hi2c1, OLED_I2C_ADDR, 0x00, 1, &cmd, 1, 10);
}

void OLED_WriteData(uint8_t data) {
    HAL_I2C_Mem_Write(&hi2c1, OLED_I2C_ADDR, 0x40, 1, &data, 1, 10);
}

/* --------------------------------------------------------------------------
 * FP1 – Initialisation du contrôleur SSD1306
 * -------------------------------------------------------------------------- */
void OLED_Fill(uint8_t color) {
    for (uint8_t page = 0; page < 8; page++) {
        OLED_WriteCommand(0xB0 + page);
        OLED_WriteCommand(0x00);
        OLED_WriteCommand(0x10);
        for (uint8_t col = 0; col < 128; col++)
            OLED_WriteData(color);
    }
}

void OLED_Init(void) {
    HAL_Delay(100);
    OLED_WriteCommand(0xAE);
    OLED_WriteCommand(0x20);
    OLED_WriteCommand(0x00);
    OLED_WriteCommand(0xC8);
    OLED_WriteCommand(0xA1);
    OLED_WriteCommand(0x8D);
    OLED_WriteCommand(0x14);
    OLED_WriteCommand(0xAF);
    OLED_Fill(0x00);
}

/* --------------------------------------------------------------------------
 * FP1 – Police ASCII 5x8 et affichage de texte
 * -------------------------------------------------------------------------- */
const uint8_t font5x8[96][5] = {
  {0x00,0x00,0x00,0x00,0x00}, {0x00,0x00,0x5F,0x00,0x00}, {0x00,0x07,0x00,0x07,0x00}, {0x14,0x7F,0x14,0x7F,0x14},
  {0x24,0x2A,0x7F,0x2A,0x12}, {0x23,0x13,0x08,0x64,0x62}, {0x36,0x49,0x55,0x22,0x50}, {0x00,0x05,0x03,0x00,0x00},
  {0x00,0x1C,0x22,0x41,0x00}, {0x00,0x41,0x22,0x1C,0x00}, {0x08,0x2A,0x1C,0x2A,0x08}, {0x08,0x08,0x3E,0x08,0x08},
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  {0x00,0x00,0x7F,0x00,0x00}, {0x00,0x41,0x36,0x08,0x00}, {0x08,0x08,0x2A,0x1C,0x08}, {0x08,0x1C,0x2A,0x08,0x08}
};

void OLED_SetCursor(uint8_t x, uint8_t y) {
    OLED_WriteCommand(0xB0 + y);
    OLED_WriteCommand(x & 0x0F);
    OLED_WriteCommand(0x10 | (x >> 4));
}

void OLED_WriteChar(char c) {
    if (c < 32 || c > 126) return;
    for (uint8_t i = 0; i < 5; i++)
        OLED_WriteData(font5x8[c - 32][i]);
    OLED_WriteData(0x00);
}

void OLED_WriteString(char *str, uint8_t x, uint8_t y) {
    OLED_SetCursor(x, y);
    while (*str) OLED_WriteChar(*str++);
}
